## Kconfig
```kconfig
#
# Copyright 2014, NICTA
#
# This software may be distributed and modified according to the terms of
# the BSD 2-Clause license. Note that NO WARRANTY is provided.
# See "LICENSE_BSD2.txt" for details.
#
# @TAG(NICTA_BSD)
#

mainmenu "CAmkES project configuration"

config COMMON_PATH
    string
    option env="COMMON_PATH"

menu "Kernel"
    source "kernel/Kconfig"
endmenu

menu "Libraries"
    source "libs/libmuslc/Kconfig"
    source "libs/libsel4/Kconfig"
    source "libs/libsel4muslcsys/Kconfig"
    source "libs/libsel4muslccamkes/Kconfig"
    source "libs/libsel4platsupport/Kconfig"
    source "libs/libsel4utils/Kconfig"
    source "libs/libcpio/Kconfig"
    source "libs/libelf/Kconfig"
    source "libs/libsel4bench/Kconfig"
    source "libs/libsel4sync/Kconfig"
    source "libs/libsel4vspace/Kconfig"
    source "libs/libsel4vka/Kconfig"
    source "libs/libethdrivers/Kconfig"
    source "libs/liblwip/Kconfig"
    source "libs/libplatsupport/Kconfig"
    source "libs/libsdhcdrivers/Kconfig"
    source "libs/libsel4dma/Kconfig"
    source "libs/libsel4debug/Kconfig"
    source "libs/libutils/Kconfig"
    source "libs/libsel4simple/Kconfig"
    source "libs/libsel4simple-stable/Kconfig"
    source "libs/libsel4simple-default/Kconfig"
    source "libs/libsel4bga/Kconfig"
    source "libs/libredis/Kconfig"
endmenu

menu "Applications"
    source "apps/capdl-loader-experimental/Kconfig"
    source "apps/uart/Kconfig"
    source "apps/uartsabre/Kconfig"
    source "apps/epit/Kconfig"
    source "apps/keyboard/Kconfig"
    source "apps/dma-example/Kconfig"
    source "apps/dma-exampleflat/Kconfig"
    source "apps/smartmeter/Kconfig"
    source "apps/DARPA/Kconfig"
    source "apps/filesystem/Kconfig"
    source "apps/microbench/Kconfig"
    source "apps/redis/Kconfig"
    source "apps/ultterminal/Kconfig"
    source "apps/aeroplage/Kconfig"
    source "apps/bilbyfs/Kconfig"

    menu "Examples"
        source "apps/simple/Kconfig"
        source "apps/simpleverification/Kconfig"
        source "apps/dataport/Kconfig"
        source "apps/event/Kconfig"
        source "apps/eventnative/Kconfig"
        source "apps/filter/Kconfig"
        source "apps/terminal/Kconfig"
        source "apps/mutex/Kconfig"
        source "apps/lockserver/Kconfig"
        source "apps/prodcons/Kconfig"
        source "apps/oneplacebuffer/Kconfig"
        source "apps/multiclient/Kconfig"
    endmenu

    menu "Integration tests"
        source "apps/simpleflat/Kconfig"
        source "apps/simpledirect/Kconfig"
        source "apps/rotate/Kconfig"
        source "apps/adder/Kconfig"
        source "apps/socket/Kconfig"
        source "apps/multiplier/Kconfig"
        source "apps/selfconnectedevent/Kconfig"
        source "apps/selfconnectedprocedure/Kconfig"
        source "apps/testrpcthreadsafe/Kconfig"
        source "apps/testrpccall/Kconfig"
        source "apps/exchangestring/Kconfig"
    endmenu
endmenu

source "tools/camkes/Kconfig"
source "$COMMON_PATH/Kconfig"
```

## apps/selfconnectedprocedure/Kconfig
```kconfig
#
# Copyright 2014, NICTA
#
# This software may be distributed and modified according to the terms of
# the GNU General Public License version 2. Note that NO WARRANTY is provided.
# See "LICENSE_GPLv2.txt" for details.
#
# @TAG(NICTA_GPL)
#

config APP_SELFCONNECTEDPROCEDURE
    bool "Self-connected procedure example"
    default n
    help
        An example of a component with a procedure interface connected to the
        same component.
```

## apps/testrpccall/Kconfig
```kconfig
#
# Copyright 2014, NICTA
#
# This software may be distributed and modified according to the terms of
# the GNU General Public License version 2. Note that NO WARRANTY is provided.
# See "LICENSE_GPLv2.txt" for details.
#
# @TAG(NICTA_GPL)
#

config APP_TESTRPCCALL
    bool "Test for seL4RPCCall correctly saving reply cap"
    default n
    help
        The seL4RPCCall connector previously did not save the reply cap
        necessary for returning from an invocation. This application is
        designed to provoke a cap fault if this problem exists.
        JIRA: CAMKES-170.
```

## apps/testrpcthreadsafe/Kconfig
```kconfig
#
# Copyright 2014, NICTA
#
# This software may be distributed and modified according to the terms of
# the GNU General Public License version 2. Note that NO WARRANTY is provided.
# See "LICENSE_GPLv2.txt" for details.
#
# @TAG(NICTA_GPL)
#

config APP_TESTRPCTHREADSAFE
    bool "Test for seL4RPC being thread safe"
    default n
    help
        Currently the seL4RPC connector type is not thread safe. If two threads
        attempt to invoke the same outgoing interface, their send order is not
        guaranteed to be the same as their wait order. The effect of this is
        that one of them can receive the response intended for the other. It is
        even possible for one of them to receive a message *from* the other.
        JIRA: CAMKES-171.
```

## apps/ultterminal/Kconfig
```kconfig
#
# Copyright 2014, NICTA
#
# This software may be distributed and modified according to the terms of
# the GNU General Public License version 2. Note that NO WARRANTY is provided.
# See "LICENSE_GPLv2.txt" for details.
#
# @TAG(NICTA_GPL)
#

# This file describes build menu configuration options. You can ignore this
# unless you want to implement some pre-compilation configuration options.

config APP_ULTTERMINAL
    bool "Multi-level secure terminal prototype"
    default n
    help
        A prototype of a multi-level secure terminal constructed as a case
        study of how the ULT, ARM model and CAmkES work fit together.
```
